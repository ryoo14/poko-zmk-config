## config/boards/shields/poko/Kconfig.defconfig
```kconfig
if SHIELD_poko_LEFT

config ZMK_KEYBOARD_NAME
    default "POKO"

endif

if SHIELD_poko_RIGHT

config ZMK_KEYBOARD_NAME
    default "POKO"

# 右手をセントラル（PC と BLE 接続する親）にする。
# トラボが右手にあるので、ポインタの高頻度データを分割リンクに流さずに済む。
config ZMK_SPLIT_ROLE_CENTRAL
    default y

endif

if SHIELD_poko_LEFT || SHIELD_poko_RIGHT

config ZMK_SPLIT
    default y

endif
```

## config/boards/shields/poko/Kconfig.shield
```kconfig
config SHIELD_poko_LEFT
    def_bool $(shields_list_contains,poko_left)

config SHIELD_poko_RIGHT
    def_bool $(shields_list_contains,poko_right)
```

## config/west.yml
```yaml
manifest:
  remotes:
    - name: cormoran
      url-base: https://github.com/cormoran
  projects:
    # DYA Studio（Custom Studio Protocol）対応の ZMK フォーク。
    # https://studio.dya.cormoran.works/developer-guide/level-2
    # ガイドは branch 指定だが、上流の変更をそのまま踏まないよう commit で固定する。
    - name: zmk
      remote: cormoran
      revision: e5c9b6915b56801193e359dd9bad4a167ce0d1b8   # main+dya @ 2026-07-25
      import:
        file: app/west.yml
    # 上の zmk の app/west.yml が取り込む zephyr を、フォーク側指定のものに差し替える。
    # ここに書いた project が import より優先される。
    - name: zephyr
      remote: cormoran
      revision: 7c6b4cc486ecb41a68d9c2b1def2bb3178fbb826   # v4.1.0+zmk-fixes+nrf-half-duplex-uart
      clone-depth: 1
      import:
        name-blocklist:
          - ci-tools
          - hal_altera
          - hal_cypress
          - hal_infineon
          - hal_microchip
          - hal_nxp
          - hal_openisa
          - hal_xtensa
          - hal_st
          - hal_ti
          - loramac-node
          - mcuboot
          - mcumgr
          - net-tools
          - openthread
          - edtt
          - trusted-firmware-m

    # --- コアモジュール ---
    - name: zmk-feature-custom-settings
      remote: cormoran
      revision: c6a7fef3a3be3d3ace5de9a4b0628c6418cd1f3f   # main @ 2026-07-22
    - name: zmk-feature-fast-keymap
      remote: cormoran
      revision: 8dac76de0ba38588ba39ca498910e24f8332bc6b   # main @ 2026-07-18

    # --- Trackball タブ ---
    # PMW3610 ドライバ。compatible / CONFIG 名を変えるならここと
    # poko_right.overlay / poko_right.conf の3箇所を揃える。
    - name: zmk-driver-pmw3610-with-custom-studio-rpc
      remote: cormoran
      revision: 5c34ea0eec246a1c986111417cd779b53144629a   # main @ 2026-07-22
    - name: zmk-module-runtime-input-processor
      remote: cormoran
      revision: 43618985f8c9d5457cc333b7ca0733f2d361911e   # main @ 2026-07-19
  self:
    path: config
```
