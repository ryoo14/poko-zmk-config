/*
 * poko 左手（ペリフェラル・トラックボールなし）
 *
 * col-offset は既定の 0 のままなので、物理列0-5 = 論理列0-5。
 * 左メイン基板にはセンサーが無いので SPI/PMW3610 は一切書かない
 *   → クロックも通信も出ず、無駄な電力を食わない（設計書 §12.7）。
 *
 * kscan は poko.dtsi の include より前に置く（poko.dtsi の chosen が &kscan0 を参照するため）。
 */

#include <zephyr/dt-bindings/gpio/gpio.h>

/ {
    /*
     * マトリクス 4行 × 6列（24キー）
     *
     * ⚠ いまは【試作基板】のピン割当（v0.1-proto と同一）。
     *   本番基板 left.kicad_pcb の割当は下のコメントアウト側。戻すときは
     *   ピン番号だけでなく diode-direction と GPIO フラグも必ずセットで戻すこと。
     *
     * ダイオード向き:
     *   試作基板 = ROW→COL に導通 → row2col（ROW が出力 / COL が入力・プルダウン）
     *   本番基板 = COL→ROW に導通 → col2row（COL が出力 / ROW が入力・プルダウン）
     */
    kscan0: kscan {
        compatible = "zmk,kscan-gpio-matrix";
        diode-direction = "row2col";
        wakeup-source;

        /* row2col なので row = 出力 / col = 入力（プルダウン） */
        /* 本番基板（col2row）用:
        row-gpios
            = <&gpio0  3 (GPIO_ACTIVE_HIGH | GPIO_PULL_DOWN)>   // ROW0 = D1  / P0.03
            , <&gpio0  4 (GPIO_ACTIVE_HIGH | GPIO_PULL_DOWN)>   // ROW1 = D4  / P0.04
            , <&gpio0  5 (GPIO_ACTIVE_HIGH | GPIO_PULL_DOWN)>   // ROW2 = D5  / P0.05
            , <&gpio1 11 (GPIO_ACTIVE_HIGH | GPIO_PULL_DOWN)>   // ROW3 = D6  / P1.11
            ;
        col-gpios
            = <&gpio0  2 GPIO_ACTIVE_HIGH>   // COL0 = D0  / P0.02
            , <&gpio0 28 GPIO_ACTIVE_HIGH>   // COL1 = D2  / P0.28
            , <&gpio0 29 GPIO_ACTIVE_HIGH>   // COL2 = D3  / P0.29
            , <&gpio1 13 GPIO_ACTIVE_HIGH>   // COL3 = D8  / P1.13
            , <&gpio1 14 GPIO_ACTIVE_HIGH>   // COL4 = D9  / P1.14
            , <&gpio1 15 GPIO_ACTIVE_HIGH>   // COL5 = D10 / P1.15
            ;
        */
        row-gpios
            = <&gpio1 11 GPIO_ACTIVE_HIGH>   // ROW0 = D6 / P1.11
            , <&gpio0  5 GPIO_ACTIVE_HIGH>   // ROW1 = D5 / P0.05
            , <&gpio0  4 GPIO_ACTIVE_HIGH>   // ROW2 = D4 / P0.04
            , <&gpio0 29 GPIO_ACTIVE_HIGH>   // ROW3 = D3 / P0.29
            ;

        col-gpios
            = <&gpio0 28 (GPIO_ACTIVE_HIGH | GPIO_PULL_DOWN)>   // COL0 = D2  / P0.28
            , <&gpio0  3 (GPIO_ACTIVE_HIGH | GPIO_PULL_DOWN)>   // COL1 = D1  / P0.03
            , <&gpio1 12 (GPIO_ACTIVE_HIGH | GPIO_PULL_DOWN)>   // COL2 = D7  / P1.12
            , <&gpio1 13 (GPIO_ACTIVE_HIGH | GPIO_PULL_DOWN)>   // COL3 = D8  / P1.13
            , <&gpio1 14 (GPIO_ACTIVE_HIGH | GPIO_PULL_DOWN)>   // COL4 = D9  / P1.14
            , <&gpio1 15 (GPIO_ACTIVE_HIGH | GPIO_PULL_DOWN)>   // COL5 = D10 / P1.15
            ;
    };
};

#include "poko.dtsi"
